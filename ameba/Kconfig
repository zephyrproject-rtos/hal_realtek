## ameba/Kconfig
```kconfig
# Copyright (c) 2024 Realtek Semiconductor Corp.
# SPDX-License-Identifier: Apache-2.0

if SOC_FAMILY_REALTEK_AMEBA

config REALTEK_AMEBA_HAL_LIB
	bool "RealTek Ameba HAL library"
	default y
	# used in os_wrapper_task.c
	select THREAD_ABORT_HOOK
	select THREAD_CUSTOM_DATA
	help
	  This option enables the Realtek Ameba HAL library.

rsource "ameba*/Kconfig"
rsource "common/wifi/Kconfig"
rsource "common/bluetooth/Kconfig"
rsource "common/rtk_coex/Kconfig"

endif # SOC_FAMILY_REALTEK_AMEBA
```

## ameba/amebasmart/Kconfig
```kconfig
# Copyright (c) 2026 Realtek Semiconductor Corp.
# SPDX-License-Identifier: Apache-2.0

config ARM_CORE_CA32
	bool
	default y if SOC_RTL8730E_CA32

config ARM_CORE_CM4
	bool
	default y if SOC_RTL8730E_KM4

config ARM_CORE_CM0
	bool
	default y if SOC_RTL8730E_KM0

config AS_INIC_NP
	bool "Ameba WiFi network-processor (WHC NP) role"
	depends on SOC_RTL8730E_KM4
	help
	  Run the 802.11 MAC/PHY driver and the WHC IPC device on the KM4,
	  serving the CA32 WHC host.  Links the prebuilt lib_wifi_whc_np from
	  the blob checkout.

config WIFI_FW_EN
	bool "Ameba WiFi MAC firmware on the LP core"
	depends on SOC_RTL8730E_KM0
	help
	  Run the WiFi MAC real-time firmware tasks on the KM0.  Links the
	  prebuilt lib_wifi_fw from the blob checkout.
```

## ameba/common/rtk_coex/Kconfig
```kconfig
# Copyright (c) 2024 Realtek Semiconductor Corp.
# SPDX-License-Identifier: Apache-2.0

if REALTEK_AMEBA_ZEPHYR_WIFI

config BT_COEXIST
	bool "Enable CoExist"
	default y if !SOC_SERIES_AMEBAD

	select COEXIST_HOST if !SINGLE_CORE_WIFI

	select ZEPHYR_SDK

config COEXIST_HOST
	bool
config COEXIST_DEV
	bool
config ZEPHYR_SDK
	bool

if BT_COEXIST && !SOC_SERIES_AMEBAD

config COEXIST_EXT
	bool "Enable Ext Coex Support"
	default n
	select COEX_EXT_CHIP_SUPPORT

choice COEX_EXT_PTA_MODE
	prompt "PTA Mode"
	depends on COEXIST_EXT
	default EXT_PTA_MODE_SIMPLE
	config EXT_PTA_MODE_SIMPLE
		bool "PTA Mode Simple"
	config EXT_PTA_MODE_MULTIPLE
		bool "PTA Mode Multiple"
endchoice

choice COEX_EXT_PROTOCOL
	prompt "Ext Protocol"
	depends on COEXIST_EXT
	default EXT_PROTOCOL_WPAN
	config EXT_PROTOCOL_WPAN
		bool "Ext WPAN"
	config EXT_PROTOCOL_BT
		bool "Ext BT"
	config EXT_PROTOCOL_BT_WPAN
		bool "Ext BT&WPAN"
endchoice

choice COEX_EXT_PRIORITY_MODE
	prompt "Priority Mode"
	depends on COEXIST_EXT
	default EXT_PRIORITY_DIRECTIONAL
	config EXT_PRIORITY_DIRECTIONAL
		bool "Directional"
	config EXT_PRIORITY_STATIC
		depends on EXT_PTA_MODE_SIMPLE
		bool "Static"
endchoice

choice COEX_EXT_REQUEST_POLAR
	prompt "Request Polar"
	depends on COEXIST_EXT
	default EXT_REQUEST_POLAR_HIGH
	config EXT_REQUEST_POLAR_HIGH
		bool "Request Active High"
	config EXT_REQUEST_POLAR_LOW
		depends on EXT_PTA_MODE_SIMPLE
		bool "Request Active Low"
endchoice

choice COEX_EXT_GNT_POLAR
	prompt "Gnt Polar"
	depends on COEXIST_EXT
	default EXT_GNT_POLAR_LOW
	config EXT_GNT_POLAR_LOW
		bool "Gnt Active Low"
	config EXT_GNT_POLAR_HIGH
		depends on EXT_PTA_MODE_SIMPLE
		bool "Gnt Active High"
endchoice

config EXT_PRI_DET_TIME
	int "Priority Det Time"
	depends on COEXIST_EXT
	range 0 254
	# 2 for RTL8771H; 0 for Silicon Thread RCP
	default 2

config EXT_TRX_DET_TIME
	int "TRX Det Time"
	depends on COEXIST_EXT
	range 0 254
	# 8 for RTL8771H; 20 for Silicon Thread RCP
	default 8

# PTA PINMUX PIN set
config EXT_PTA_PIN_REQ
	string "Pin PTA Request"
	depends on COEXIST_EXT
	default "PB_0" if SOC_SERIES_AMEBADPLUS
	default "PA_21" if SOC_SERIES_AMEBAG2
	default "PA_26" if SOC_SERIES_AMEBAD

config EXT_PTA_PIN_PRI
	string "Pin PTA Priority"
	depends on COEXIST_EXT
	default "PB_2" if SOC_SERIES_AMEBADPLUS
	default "PA_18" if SOC_SERIES_AMEBAG2
	default "PB_1" if SOC_SERIES_AMEBAD

config EXT_PTA_PIN_GNT
	string "Pin PTA Gnt"
	depends on COEXIST_EXT
	default "PB_1" if SOC_SERIES_AMEBADPLUS
	default "PA_19" if SOC_SERIES_AMEBAG2
	default "PA_27" if SOC_SERIES_AMEBAD

config COEX_EXT_CHIP_SUPPORT
	bool

endif # BT_COEXIST && !SOC_SERIES_AMEBAD

endif # REALTEK_AMEBA_ZEPHYR_WIFI
```

## ameba/common/wifi/Kconfig
```kconfig
# Copyright (c) 2024 Realtek Semiconductor Corp.
# SPDX-License-Identifier: Apache-2.0

config REALTEK_AMEBA_ZEPHYR_WIFI
	bool "RealTek Ameba Zephyr WIFI"
	default y
	help
	  This option enables the Realtek Ameba WIFI.

if REALTEK_AMEBA_ZEPHYR_WIFI
config WLAN
	bool "enable wifi"
	default y

config AS_INIC_AP
	bool

config AS_INIC_NP
	bool

config WIFI_FW_EN
	bool

config SINGLE_CORE_WIFI
	bool
	default y if SOC_SERIES_AMEBAD

endif # REALTEK_AMEBA_ZEPHYR_WIFI
```

## bee/drivers/Kconfig
```kconfig
# Copyright (c) 2026, Realtek Semiconductor Corporation
# SPDX-License-Identifier: Apache-2.0

menu "HAL Realtek Bee Drivers"
orsource "adc/Kconfig"
orsource "bluetooth/Kconfig"
orsource "can/Kconfig"
orsource "codec/Kconfig"
orsource "dma/Kconfig"
orsource "efuse/Kconfig"
orsource "gpio/Kconfig"
orsource "i2c/Kconfig"
orsource "i2s/Kconfig"
orsource "ir/Kconfig"
orsource "irq/Kconfig"
orsource "keyscan/Kconfig"
orsource "mac_802154/Kconfig"
orsource "pinmux/Kconfig"
orsource "pwm/Kconfig"
orsource "qdec/Kconfig"
orsource "rcc/Kconfig"
orsource "rtc/Kconfig"
orsource "sdhc/Kconfig"
orsource "spi/Kconfig"
orsource "timer/Kconfig"
orsource "uart/Kconfig"
orsource "usb/Kconfig"
orsource "wdt/Kconfig"
endmenu

config REALTEK_BEE_COMMON_DRIVER
	bool
	default y
	depends on !(SOC_SERIES_RTL8752H || SOC_SERIES_RTL87X2G)

config WRAP_REALTEK_BEE_ADC
	bool
	default y
	depends on HAL_REALTEK_BEE_ADC
	select REALTEK_BEE_ADC

config WRAP_REALTEK_BEE_CAN
	bool
	default y
	depends on HAL_REALTEK_BEE_CAN
	select REALTEK_BEE_CAN

config WRAP_REALTEK_BEE_CODEC
	bool
	default y
	depends on HAL_REALTEK_BEE_CODEC
	select REALTEK_BEE_CODEC

config WRAP_REALTEK_BEE_DMA
	bool
	default y
	depends on HAL_REALTEK_BEE_DMA
	select REALTEK_BEE_DMA

config WRAP_REALTEK_BEE_GPIO
	bool
	default y
	depends on HAL_REALTEK_BEE_GPIO
	select REALTEK_BEE_GPIO

config WRAP_REALTEK_BEE_I2C
	bool
	default y
	depends on HAL_REALTEK_BEE_I2C
	select REALTEK_BEE_I2C

config WRAP_REALTEK_BEE_I2S
	bool
	default y
	depends on HAL_REALTEK_BEE_I2S
	select REALTEK_BEE_I2S

config WRAP_REALTEK_BEE_IR
	bool
	default y
	depends on HAL_REALTEK_BEE_IR
	select REALTEK_BEE_IR

config WRAP_REALTEK_BEE_KEYSCAN
	bool
	default y
	depends on HAL_REALTEK_BEE_KEYSCAN
	select REALTEK_BEE_KEYSCAN

config WRAP_REALTEK_BEE_NVIC
	bool
	default y
	select REALTEK_BEE_NVIC

config WRAP_REALTEK_BEE_PINMUX
	bool
	default y
	depends on HAL_REALTEK_BEE_PINMUX
	select REALTEK_BEE_PINMUX

config WRAP_REALTEK_BEE_AON_QDEC
	bool
	default y
	depends on HAL_REALTEK_BEE_AON_QDEC
	select REALTEK_BEE_AON_QDEC

config WRAP_REALTEK_BEE_QDEC
	bool
	default y
	depends on HAL_REALTEK_BEE_QDEC
	select REALTEK_BEE_QDEC

config WRAP_REALTEK_BEE_RCC
	bool
	default y
	depends on HAL_REALTEK_BEE_RCC
	select REALTEK_BEE_RCC

config WRAP_REALTEK_BEE_RTC
	bool
	default y
	depends on HAL_REALTEK_BEE_RTC
	select REALTEK_BEE_RTC

config WRAP_REALTEK_BEE_SDHC
	bool
	default y
	depends on HAL_REALTEK_BEE_SDHC
	select REALTEK_BEE_SDHC

config WRAP_REALTEK_BEE_SPI
	bool
	default y
	depends on HAL_REALTEK_BEE_SPI
	select REALTEK_BEE_SPI

config WRAP_REALTEK_BEE_TIM
	bool
	default y
	depends on HAL_REALTEK_BEE_TIM
	select REALTEK_BEE_TIMER

config WRAP_REALTEK_BEE_ENHTIM
	bool
	default y
	depends on HAL_REALTEK_BEE_ENHTIM
	select REALTEK_BEE_ENHTIMER

config WRAP_REALTEK_BEE_UART
	bool
	default y
	depends on HAL_REALTEK_BEE_UART
	select REALTEK_BEE_UART

config WRAP_REALTEK_BEE_USB
	bool
	default y
	depends on HAL_REALTEK_BEE_USB
	select REALTEK_BEE_USB

config WRAP_REALTEK_BEE_AON_WDT
	bool
	default y
	depends on HAL_REALTEK_BEE_AON_WDT
	select REALTEK_BEE_AON_WDT

config WRAP_REALTEK_BEE_CORE_WDT
	bool
	default y
	depends on HAL_REALTEK_BEE_CORE_WDT
	select REALTEK_BEE_CORE_WDT
```

## bee/drivers/efuse/Kconfig
```kconfig
# Copyright (c) 2026, Realtek Semiconductor Corporation
# SPDX-License-Identifier: Apache-2.0

config REALTEK_BEE_EFUSE
	bool "Realtek Bee eFuse driver"
	default n
	depends on SOC_SERIES_RTL87X2G
	help
	  Enable the eFuse driver for Realtek Bee rtl87x2g. Provides access
	  to chip EUID, system type, and USB configuration stored in eFuse
	  via the TrustZone NSC interface.
```

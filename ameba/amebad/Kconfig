## ameba/amebad/Kconfig
```kconfig
# Copyright (c) 2024 Realtek Semiconductor Corp.
# SPDX-License-Identifier: Apache-2.0

config ARM_CORE_CM4
	bool
	default y if SOC_SERIES_AMEBAD

config SOC_SERIES_AMEBAD
	select SINGLE_CORE_WIFI if WLAN
```

## ameba/amebadplus/Kconfig
```kconfig
# Copyright (c) 2024 Realtek Semiconductor Corp.
# SPDX-License-Identifier: Apache-2.0

config ARM_CORE_CM4
	bool
	default y if SOC_SERIES_AMEBADPLUS
```

## bee/Kconfig
```kconfig
# Copyright (c) 2026, Realtek Semiconductor Corporation
# SPDX-License-Identifier: Apache-2.0

rsource "drivers/Kconfig"

config SOC_SERIES_RTL8752H
    bool
```
